#include "bsp_ssd1306.h"
#include "i2c.h"
#include <string.h>

/* 0.96" 128x64 SSD1306 I2C 简易驱动：全屏显存 + 5x7 字体（可 2 倍放大） */

#define SSD1306_ADDR  (0x3C << 1)   /* 7 位地址 0x3C，HAL 要左移 1 位成 0x78 */
#define SSD1306_W     128
#define SSD1306_H     64

/* 显存：横向寻址，1 字节 = 竖着 8 个点，1024 字节 */
static uint8_t fb[SSD1306_W * SSD1306_H / 8];
static uint8_t dev_ok = 0;

/* 5x7 ASCII 字体（0x20~0x7E），每字符 5 列，LSB 在上 */
static const uint8_t font5x7[] = {
    0x00,0x00,0x00,0x00,0x00,  0x00,0x00,0x5F,0x00,0x00,  0x00,0x07,0x00,0x07,0x00,  0x14,0x7F,0x14,0x7F,0x14, /* ' ' ! " # */
    0x24,0x2A,0x7F,0x2A,0x12,  0x23,0x13,0x08,0x64,0x62,  0x36,0x49,0x55,0x22,0x50,  0x00,0x05,0x03,0x00,0x00, /* $ % & ' */
    0x00,0x1C,0x22,0x41,0x00,  0x00,0x41,0x22,0x1C,0x00,  0x14,0x08,0x3E,0x08,0x14,  0x08,0x08,0x3E,0x08,0x08, /* ( ) * + */
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    0x00,0x00,0x7F,0x00,0x00,  0x00,0x41,0x36,0x08,0x00,  0x08,0x08,0x2A,0x1C,0x08,                             /* | } ~   */
};

static HAL_StatusTypeDef ssd_cmd(uint8_t c)
{
  /* 控制字节 0x00 = 后面是命令 */
  return HAL_I2C_Mem_Write(&hi2c1, SSD1306_ADDR, 0x00, I2C_MEMADD_SIZE_8BIT, &c, 1, 20);
}

static HAL_StatusTypeDef ssd_data(const uint8_t *d, uint16_t n)
{
  /* 控制字节 0x40 = 后面是显存数据（连续流） */
  return HAL_I2C_Mem_Write(&hi2c1, SSD1306_ADDR, 0x40, I2C_MEMADD_SIZE_8BIT,
                           (uint8_t *)d, n, 50);
}

uint8_t SSD1306_IsOK(void)
{
  return dev_ok;
}

void SSD1306_Init(void)
{
  static const uint8_t seq[] = {
    0xAE,             /* 关显示 */
    0xD5, 0x80,       /* 时钟分频 */
    0xA8, 0x3F,       /* 复用率 63（64 行） */
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    0xAF,             /* 开显示 */
  };
  if (HAL_I2C_IsDeviceReady(&hi2c1, SSD1306_ADDR, 3, 100) != HAL_OK)
  {
    dev_ok = 0;                    /* 屏没接/地址不对：跳过，不卡任务 */
    return;
  }
  for (uint32_t i = 0; i < sizeof(seq); i++)
  {
    (void)ssd_cmd(seq[i]);
  }
  dev_ok = 1;
  SSD1306_Fill(0x00);
  SSD1306_Flush();
}

void SSD1306_Fill(uint8_t pattern)
{
  memset(fb, pattern, sizeof(fb));
}

static void set_pixel(uint8_t x, uint8_t y)
{
  if (x >= SSD1306_W || y >= SSD1306_H) return;
  fb[x + (y >> 3) * SSD1306_W] |= (uint8_t)(1u << (y & 7));
}

void SSD1306_DrawChar(uint8_t x, uint8_t y, char c, uint8_t scale)
{
  if (c < 32 || c > 126) c = '?';
  const uint8_t *g = &font5x7[(c - 32) * 5];
  for (uint8_t col = 0; col < 5; col++)
  {
    for (uint8_t row = 0; row < 8; row++)
    {
      if (g[col] & (1u << row))
      {
        for (uint8_t sx = 0; sx < scale; sx++)
          for (uint8_t sy = 0; sy < scale; sy++)
            set_pixel((uint8_t)(x + col * scale + sx), (uint8_t)(y + row * scale + sy));
      }
    }
  }
}

void SSD1306_DrawString(uint8_t x, uint8_t y, const char *s, uint8_t scale)
{
  while (*s)
  {
    SSD1306_DrawChar(x, y, *s++, scale);
    x = (uint8_t)(x + 6 * scale);          /* 5 列字形 + 1 列空隙 */
  }
}

void SSD1306_Flush(void)
{
  if (!dev_ok) return;
  (void)ssd_cmd(0x21); (void)ssd_cmd(0);   (void)ssd_cmd(127);  /* 列范围 0~127 */
  (void)ssd_cmd(0x22); (void)ssd_cmd(0);   (void)ssd_cmd(7);    /* 页范围 0~7 */
  for (uint8_t p = 0; p < 8; p++)
  {
    (void)ssd_data(&fb[p * SSD1306_W], SSD1306_W);
  }
}
